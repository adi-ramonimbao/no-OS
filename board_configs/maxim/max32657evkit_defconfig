## capi/Kconfig
```kconfig
menuconfig CAPI
	bool "CAPI (Common API) abstraction layer"
	default n
	help
	  Enable the CAPI common-API abstraction layer. CAPI provides a
	  platform-neutral dispatcher layer (capi/src) with platform-specific
	  backends (capi/platform/<platform>). Each peripheral module below
	  enables its dispatcher; the matching backend is compiled from the
	  active platform's directory and selects PS vs PL hardware internally
	  via #ifdef on the BSP-provided XPAR_* macros.

if CAPI

config CAPI_UART
	bool "CAPI UART"
	default n

config CAPI_USB_UART
	bool "CAPI USB UART (CDC-ACM)"
	depends on CAPI_UART && CAPI_IRQ
	default n
	help
	  Enable the USB CDC-ACM backend of CAPI UART on platforms that
	  provide one (currently Maxim MAX32690). The device enumerates as a
	  virtual serial port and is driven through the regular capi_uart_*
	  API by selecting the platform's USB UART ops at init.

config CAPI_ALLOC
	bool "CAPI alloc"
	default n

config CAPI_TIME
	bool "CAPI time"
	default n

config CAPI_GPIO
	bool "CAPI GPIO"
	default n

config CAPI_IRQ
	bool "CAPI IRQ"
	default n

config CAPI_SPI
	bool "CAPI SPI"
	default n

config CAPI_TIMER
	bool "CAPI timer"
	default n

config CAPI_I2C
	bool "CAPI I2C"
	default n

config CAPI_DMA
	bool "CAPI DMA"
	default n

config CAPI_WDT
	bool "CAPI WDT"
	default n

config CAPI_PINT
	bool "CAPI PINT"
	default n

endif # CAPI
```

## projects/capi_selftest/Kconfig
```kconfig
menu "capi_selftest Configuration"

choice CAPI_SELFTEST_EXAMPLE
	prompt "Example variant"
	default CAPI_SELFTEST_BASIC_EXAMPLE

config CAPI_SELFTEST_BASIC_EXAMPLE
	bool "Basic example"
	help
	  Basic CAPI self-test example.

config CAPI_SELFTEST_LOOPBACK_EXAMPLE
	bool "Loopback example"
	help
	  CAPI loopback test example (SPI, I2C, GPIO, IRQ, DMA, timer tests).

config CAPI_SELFTEST_USB_UART_EXAMPLE
	bool "USB UART example"
	depends on CAPI_USB_UART && CAPI_TIME
	help
	  Runs the self-test report over the USB CDC-ACM virtual serial port
	  and exercises the CAPI USB UART backend (transmit, line coding,
	  async transmit/receive with an interactive echo).

endchoice

endmenu
```

## projects/max32657_testing/Kconfig
```kconfig
menu "MAX32657 Testing Configutation"

choice MAX32657_TESTING_EXAMPLE
	prompt "Example variant"
	default MAX32657_TESTING_BLINKY_EXAMPLE

config MAX32657_TESTING_BLINKY_EXAMPLE
	bool "Blinky example"
	help
	  Blinky CAPI example

config MAX32657_TESTING_BUTTON_IRQ_EXAMPLE
	bool "Button IRQ example"
	help
	  Button IRQ example

config MAX32657_TESTING_BUTTON_POLLING_EXAMPLE
	bool "Button (polling) example"
	help
	  Button (polling) example

config MAX32657_TESTING_DMA_EXAMPLE
	bool "DMA example"
	help
	  DMA example

config MAX32657_TESTING_I2C_EXAMPLE
	bool "I2C example"
	help
	  I2C sending for ADALM2000 measurement example

config MAX32657_TESTING_SPI_EXAMPLE
	bool "SPI example"
	help
	  SPI example

config MAX32657_TESTING_TIMER_EXAMPLE
	bool "Timer example"
	help
	  Timer example

config MAX32657_TESTING_TMR0_EXAMPLE
	bool "TMR0 testing"
	help
	  TMR0 testing

config MAX32657_TESTING_TRNG_EXAMPLE
	bool "TRNG example"
	help
	  TRNG example

config MAX32657_TESTING_UART_ASYNC_EXAMPLE
	bool "UART (async) example"
	help
	  UART (async) example

config MAX32657_TESTING_UART_EXAMPLE
	bool "UART example"
	help
	  UART example

config MAX32657_TESTING_WDT_EXAMPLE
	bool "WDT example"
	help
	  WDT example

config MAX32657_TESTING_COUNT_EXACT_EXAMPLE
	bool "COUNT_EXACT"
	help
	  COUNT_EXACT

endchoice

endmenu
```

## projects/max32657_tz_hello/Kconfig
```kconfig
menu "max32657_tz_hello Configuration"

comment "TrustZone hello demo: no build-time options. The Secure/Non-Secure"
comment "split is driven by MSECURITY_MODE and the superbuild CMakeLists."
comment "See projects/max32657_tz_hello/README.rst."

endmenu
```

## projects/max32657_tz_keystore/Kconfig
```kconfig
menu "max32657_tz_keystore Configuration"

comment "TrustZone keystore demo: no build-time options. The Secure/Non-Secure"
comment "split is driven by MSECURITY_MODE and the superbuild CMakeLists."
comment "See projects/max32657_tz_keystore/README.rst."

endmenu
```

## projects/max32657_tz_nonsecure_only/Kconfig
```kconfig
menu "max32657_tz_nonsecure_only Configuration"

comment "Non-Secure-only TrustZone consumer: no build-time options. Links"
comment "against a Secure image built elsewhere (max32657_tz_secure_only) and"
comment "merges the two into one flashable HEX. See the project README."

endmenu
```

## projects/max32657_tz_secure_only/Kconfig
```kconfig
menu "max32657_tz_secure_only Configuration"

comment "Secure-only TrustZone producer: no build-time options. The Secure"
comment "world is emitted as separate deliverables (HEX + implib + contract)"
comment "for a Non-Secure app built elsewhere. See the project README."

endmenu
```

## projects/max32657_tz_selftest/Kconfig
```kconfig
menu "max32657_tz_selftest Configuration"

comment "TrustZone CAPI self-test: no build-time options. The Secure/Non-Secure"
comment "split is driven by MSECURITY_MODE and the superbuild CMakeLists."
comment "See projects/max32657_tz_selftest/README.rst."

endmenu
```

## projects/trustzone_hello/Kconfig
```kconfig
menu "trustzone_hello Configuration"

comment "TrustZone hello demo: no build-time options. The Secure/Non-Secure"
comment "split is driven by MSECURITY_MODE and the superbuild CMakeLists."
comment "See projects/trustzone_hello/README.rst."

endmenu
```

## projects/trustzone_nonsecure_only/Kconfig
```kconfig
menu "trustzone_nonsecure_only Configuration"

comment "Non-Secure-only TrustZone consumer: no build-time options. Links"
comment "against a Secure image built elsewhere (trustzone_secure_only) and"
comment "merges the two into one flashable HEX. See the project README."

endmenu
```

## projects/trustzone_selftest/Kconfig
```kconfig
menu "trustzone_selftest Configuration"

comment "TrustZone CAPI self-test: no build-time options. The Secure/Non-Secure"
comment "split is driven by MSECURITY_MODE and the superbuild CMakeLists."
comment "See projects/trustzone_selftest/README.rst."

endmenu
```
